VERSION ""

NS_ :

BS_:

BU_: Board Host

BO_ 256 BoardStatus: 4 Board
 SG_ Temperature : 0|16@1- (0.1,0) [-40|125] "degC" Host
 SG_ Voltage : 16|16@1+ (1,0) [0|65535] "mV" Host

BO_ 512 MotorCommand: 3 Host
 SG_ Speed : 0|16@1+ (1,0) [0|6000] "rpm" Board
 SG_ Enable : 16|1@1+ (1,0) [0|1] "" Board

VAL_ 512 Enable 0 "Off" 1 "On" ;
