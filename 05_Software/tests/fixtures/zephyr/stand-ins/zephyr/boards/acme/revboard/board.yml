## 05_Software/tests/fixtures/zephyr/tests/ztest-basic/Kconfig
```kconfig
config VERA_SKIP_DEMO
	bool "Skip one test case at run time"

config VERA_FAIL_DEMO
	bool "Fail one test case"

source "Kconfig.zephyr"
```

## 05_Software/tests/fixtures/zephyr/tests/ztest-basic/testcase.yaml
```yaml
common:
  platform_allow:
    - stm32f4_disco
  tags: vera
tests:
  vera.ztest.pass: {}
  vera.ztest.skip:
    extra_configs:
      - CONFIG_VERA_SKIP_DEMO=y
  vera.ztest.fail:
    extra_configs:
      - CONFIG_VERA_FAIL_DEMO=y
```
